## board/freescale/amherstsolo/Kconfig
```kconfig
if TARGET_AMHERSTSOLO

config SYS_CPU
	default "armv7"

config SYS_BOARD
	default "amherstsolo"

config SYS_VENDOR
	default "handera"

config SYS_SOC
	default "mx6"

config SYS_CONFIG_NAME
	default "amherstsolo"

endif
```

## board/freescale/mx6qamherstsd/Kconfig
```kconfig
if TARGET_MX6QAMHERSTSD

config SYS_CPU
	default "armv7"

config SYS_BOARD
	default "mx6qamherstsd"

config SYS_VENDOR
	default "freescale"

config SYS_SOC
	default "mx6"

config SYS_CONFIG_NAME
	default "mx6qamherstsd"

endif
```

## board/handera/amherstquad/Kconfig
```kconfig
if TARGET_AMHERSTQUAD

config SYS_CPU
	default "armv7"

config SYS_BOARD
	default "amherstquad"

config SYS_VENDOR
	default "handera"

config SYS_SOC
	default "mx6"

config SYS_CONFIG_NAME
	default "amherstquad"

endif
```

## configs/amherstquad_defconfig
```kconfig
CONFIG_SYS_EXTRA_OPTIONS="IMX_CONFIG=board/handera/amherstquad/imximage.cfg,MX6Q"
CONFIG_ARM=y
CONFIG_TARGET_AMHERSTQUAD=y
CONFIG_TARGET_AMHERST_QUAD=y
CONFIG_DM=y
CONFIG_DM_THERMAL=y
CONFIG_RWSEM_GENERIC_SPINLOCK=y
CONFIG_UNINLINE_SPIN_UNLOCK=y
CONFIG_MUTEX_SPIN_ON_OWNER=y
CONFIG_IMX_HAVE_PLATFORM_SPI_IMX=y
CONFIG_REGMAP_SPI=y
CONFIG_SPI_FSL_QUADSPI=y
CONFIG_SPI=y
CONFIG_SPI_MASTER=y
CONFIG_SPI_BITBANG=y
CONFIG_SPI_GPIO=y
CONFIG_SPI_IMX=y
CONFIG_SPI_SPIDEV=y
CONFIG_MFD_MC13XXX_SPI=y
CONFIG_SND_SPI=y
CONFIG_SND_SOC_I2C_AND_SPI=y
```

## configs/amherstsolo_defconfig
```kconfig
CONFIG_SYS_EXTRA_OPTIONS="IMX_CONFIG=board/handera/amherstsolo/imximage.cfg,MX6DL,DDR_MB=512"
CONFIG_ARM=y
CONFIG_TARGET_AMHERSTSOLO=y
```

## configs/mx6qamherstsd_defconfig
```kconfig
CONFIG_SYS_EXTRA_OPTIONS="IMX_CONFIG=board/freescale/mx6qamherstsd/imximage.cfg,MX6Q"
CONFIG_ARM=y
CONFIG_TARGET_MX6QAMHERSTSD=y
```

## configs/mx6qsabresd_defconfig
```kconfig
CONFIG_SYS_EXTRA_OPTIONS="IMX_CONFIG=board/freescale/mx6sabresd/imximage.cfg,MX6Q"
CONFIG_ARM=y
CONFIG_TARGET_MX6SABRESD=y
```
